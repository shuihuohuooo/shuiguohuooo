## config/boards/arm/aliceee/Kconfig.board
```kconfig
# Copyright (c) 2021 Nick Winans
# SPDX-License-Identifier: MIT

config BOARD_ALICEEE
	bool "aliceee"
	depends on SOC_NRF52840_QIAA
```

## config/boards/arm/fadog65/Kconfig.board
```kconfig
# Copyright (c) 2021 Nick Winans
# SPDX-License-Identifier: MIT

config BOARD_FADOG65
	bool "fadog65"
	depends on SOC_NRF52833_QIAA
```
